#define CONFIG_WIRELESS
#define ZMK_BASE_LAYER(name, LT, RT, LM, RM, LB, RB, LH, RH)                   \
    ZMK_LAYER(                                                                 \
        name,                                                                  \
                 LT RT                                                         \
                 LM RM                                                         \
        &sl 4    LB RB &kp LC(LS(LA(LG(Z))))                                   \
        &kp LGUI LH RH &kp LC(M)                                               \
    )

#include "zmk-helpers/key-labels/totem.h"
#include "base.keymap"
